## config/west.yml
```yaml
# manifest:
#   remotes:
#     - name: petejohanson
#       url-base: https://github.com/petejohanson
#     - name: zmkfirmware
#       url-base: https://github.com/zmkfirmware
#   projects:
#     - name: zmk
#       remote: zmkfirmware
#       revision: v0.3
#       import: app/west.yml
#     - name: blank-slate-zmk-module
#       remote: petejohanson
#       revision: v0.3
#   self:
#     path: config

manifest:
  remotes:
    - name: petejohanson
      url-base: https://github.com/petejohanson
  projects:
    - name: zmk
      remote: zmkfirmware
      revision: main
      import: app/west.yml
    - name: blank-slate-zmk-module
      remote: petejohanson
      revision: main
  self:
    path: config
```
